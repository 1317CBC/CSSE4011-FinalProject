## CMakeLists.txt
```
# SPDX-License-Identifier: Apache-2.0

cmake_minimum_required(VERSION 3.20.0)
find_package(Zephyr REQUIRED HINTS $ENV{ZEPHYR_BASE})
project(mycode)


FILE(GLOB app_sources src/main.c)
target_sources(app PRIVATE ${app_sources})
```

## prj.conf
```kconfig
CONFIG_SERIAL=y
CONFIG_RING_BUFFER=y
CONFIG_UART_INTERRUPT_DRIVEN=y
CONFIG_PRINTK=y

CONFIG_LV_Z_MEM_POOL_SIZE=49152
CONFIG_LV_Z_SHELL=y
CONFIG_LV_USE_MONKEY=y
CONFIG_MAIN_STACK_SIZE=4096
CONFIG_INIT_STACKS=y
CONFIG_THREAD_STACK_INFO=y
CONFIG_THREAD_NAME=y

CONFIG_DISPLAY=y
CONFIG_DISPLAY_LOG_LEVEL_ERR=y

CONFIG_LV_FONT_MONTSERRAT_12=y
CONFIG_LV_FONT_MONTSERRAT_14=y
CONFIG_LV_FONT_MONTSERRAT_16=y
CONFIG_LV_FONT_MONTSERRAT_28=y

CONFIG_I2C=y
CONFIG_I2C_ESP32=y
CONFIG_SENSOR=y
CONFIG_MPU6050=y

CONFIG_LVGL=y
CONFIG_LV_MEM_CUSTOM=y
CONFIG_LV_USE_LOG=y
CONFIG_LV_USE_LABEL=y
CONFIG_LV_USE_BTN=y
CONFIG_LV_USE_ARC=y
CONFIG_LV_USE_IMG=y
CONFIG_LV_USE_MONKEY=y
CONFIG_LV_FONT_MONTSERRAT_14=y

CONFIG_ASSERT=y
CONFIG_GPIO=y
CONFIG_NEWLIB_LIBC=y
CONFIG_NEWLIB_LIBC_FLOAT_PRINTF=y
CONFIG_DISK_ACCESS=y
CONFIG_FILE_SYSTEM=y
CONFIG_FAT_FILESYSTEM_ELM=y
CONFIG_SPI=y
CONFIG_DISK_DRIVER_SDMMC=y
CONFIG_LOG=y
CONFIG_SHELL=y

CONFIG_BT=y
CONFIG_BT_DEBUG_LOG=y
CONFIG_BT_PERIPHERAL=y
CONFIG_BT_BROADCASTER=y
CONFIG_BT_SMP=y
CONFIG_BT_SETTINGS=y
```

## src/main.c
```c
#include <zephyr/device.h>
#include <zephyr/devicetree.h>
#include <zephyr/drivers/sensor.h>
#include <zephyr/drivers/display.h>
#include <zephyr/drivers/gpio.h>
#include <lvgl.h>
#include <stdio.h>
#include <string.h>
#include <zephyr/kernel.h>
#include <math.h>
#include <zephyr/types.h>

#define LOG_LEVEL CONFIG_LOG_DEFAULT_LEVEL
#include <zephyr/logging/log.h>
LOG_MODULE_REGISTER(app);

#define RADIUS 50
#define ANGLE_STEP 5

#define NUM_SAMPLES 10
#define SAMPLE_PERIOD_MS 100
#define RAD_TO_DEG 57.2957795131

const double ACCEL_THRESHOLD = 1;  // accelerometer threshold
const double GYRO_THRESHOLD = 3.0;  // gyroscope threshold

static lv_obj_t *label;
static lv_obj_t *roll_lable;
static lv_style_t label_style;

typedef struct {
    double ax, ay, az; // calibration data for accelerometer
    double gx, gy, gz; // calibration data for gyroscope
} SensorData;


const struct device *dev;

/**
 * @brief Calculate pitch and roll angles
 * 
*/
void calculateAngles(const SensorData* data, float* pitch, float* roll) {
    if (data == NULL || pitch == NULL || roll == NULL) {
        return;
    }

    // calculate pitch angle Pitch
    *pitch = atan2f(data->ay, sqrtf(data->ax * data->ax + data->az * data->az));
    // calculate roll angle Roll
    *roll = atan2f(-data->ax, data->az);

    // convert radians to degrees
    *pitch *= 180.0f / 3.1415926f;
    *roll *= 180.0f / 3.1415926f;
}


static void accinfo(void){
    SensorData data = {0.0f, 0.0f, 0.0f, 0.0f, 0.0f, 0.0f};
    struct sensor_value accel[3], gyro[3];
    float pitch = 0.0f, roll = 0.0f;
    char pitch_str[40];
    char roll_str[40];

    // sensor_sample_fetch(dev);
    // sensor_channel_get(dev, SENSOR_CHAN_ACCEL_XYZ, accel);
    // sensor_channel_get(dev, SENSOR_CHAN_GYRO_XYZ, gyro);

    // data.ax = sensor_value_to_double(&accel[0]);
    // data.ay = sensor_value_to_double(&accel[1]);
    // data.az = sensor_value_to_double(&accel[2]);
    // data.gx = sensor_value_to_double(&gyro[0]);
    // data.gy = sensor_value_to_double(&gyro[1]);
    // data.gz = sensor_value_to_double(&gyro[2]);

    for (int i = 0; i < NUM_SAMPLES; i++) {
        sensor_sample_fetch(dev);
        sensor_channel_get(dev, SENSOR_CHAN_ACCEL_XYZ, accel);
        sensor_channel_get(dev, SENSOR_CHAN_GYRO_XYZ, gyro);

        data.ax += (sensor_value_to_double(&accel[0]) + 0.05);
        data.ay += (sensor_value_to_double(&accel[1]) - 0.18);
        data.az += (sensor_value_to_double(&accel[2]) - 10.45);
        data.gx += sensor_value_to_double(&gyro[0]);
        data.gy += sensor_value_to_double(&gyro[1]);
        data.gz += sensor_value_to_double(&gyro[2]);

        k_sleep(K_MSEC(10)); // Wait a bit between samples
    }

    data.ax = round((data.ax / NUM_SAMPLES) * 100) / 100;
    data.ay = round((data.ay / NUM_SAMPLES) * 100) / 100;
    data.az = round((data.az / NUM_SAMPLES) * 100) / 100;
    data.gx = round((data.gx / NUM_SAMPLES) * 100) / 100;
    data.gy = round((data.gy / NUM_SAMPLES) * 100) / 100;
    data.gz = round((data.gz / NUM_SAMPLES) * 100) / 100;

    double angle = atan2(data.ay, data.ax) * RAD_TO_DEG;


    if (data.ax > ACCEL_THRESHOLD || data.ay > ACCEL_THRESHOLD ||
        data.ax < -ACCEL_THRESHOLD || data.ay < -ACCEL_THRESHOLD) {
        // double angle = atan2(data.ay, data.ax) * RAD_TO_DEG;
        if ((angle > 67.5 && angle <= 112.5)) {
            sprintf(pitch_str, "back   %lf\n", (double)angle);
        } else if ((angle > 157.5 && angle <= 180) || (angle > -180 && angle <= -157.5)) {
            sprintf(pitch_str, "right   %lf\n", (double)angle);
        } else if ((angle < -67.5 && angle >= -112.5)) {
            sprintf(pitch_str, "front    %lf\n", (double)angle);
        } else if ((angle > -22.5 && angle <= 22.5) || (angle > 157.5 || angle < -157.5)) {
            sprintf(pitch_str, "Left    %lf\n", (double)angle);
        }
    }

    if (data.gz > GYRO_THRESHOLD) {
        sprintf(pitch_str, "anti   %lf\n", (double)data.gz);
    } else if (data.gz < -GYRO_THRESHOLD) {
        sprintf(pitch_str, "count   %lf\n", (double)data.gz);
    }

    // calculateAngles(&data, &pitch, &roll);
    // sprintf(pitch_str, "Pitch: %lf \n", (double)pitch);
    // sprintf(roll_str, "Roll: %lf \n", (double)roll);
    lv_label_set_text(label,pitch_str);
    // lv_label_set_text(roll_lable,roll_str);

    lv_obj_align(label, LV_ALIGN_CENTER, -10, -50);
    // lv_obj_align(roll_lable, LV_ALIGN_CENTER, -10, 0);
    

}

static void create_objects(void)
{
    lv_obj_t *scr = lv_scr_act();
    lv_obj_set_style_bg_color(scr, lv_color_hex(0x000000), LV_PART_MAIN);

    lv_style_init(&label_style);
    lv_style_set_text_font(&label_style, &lv_font_montserrat_28);
    lv_style_set_text_color(&label_style, lv_color_hex(0xFFFFFF));

    label = lv_label_create(scr);
    roll_lable = lv_label_create(scr);
    lv_obj_add_style(label, &label_style, LV_PART_MAIN);
    lv_obj_add_style(roll_lable, &label_style, LV_PART_MAIN);

    lv_label_set_text(label, "0.0\n");
    lv_label_set_text(roll_lable, "0.0\n");

    lv_obj_align(label, LV_ALIGN_CENTER, -30, -50);
    lv_obj_align(roll_lable, LV_ALIGN_CENTER, -30, 0);

    lv_obj_invalidate(scr);
    lv_refr_now(NULL);
}



int main(void)
{
    const struct device *display_dev;
    dev = device_get_binding("MPU6050");
    display_dev = DEVICE_DT_GET(DT_CHOSEN(zephyr_display));
    if (!device_is_ready(display_dev)) {
        LOG_ERR("Device not ready, aborting test");
        return 0;
    }

    if (!dev) {
        printf("Failed to find sensor device\n");
        return 1;
    }

    lv_init();

    create_objects();

    display_blanking_off(display_dev);

    while (1) {
        accinfo();
        lv_timer_handler();
        // k_sleep(K_MSEC(100));
    }
}
```

## src/IMU.c
```c
#include <zephyr/device.h>
#include <zephyr/devicetree.h>
#include <zephyr/drivers/sensor.h>
#include <zephyr/drivers/gpio.h>
#include <stdio.h>
#include <string.h>
#include <zephyr/kernel.h>
#include <zephyr/drivers/i2c.h>
#include <math.h>
#include <stdio.h>

typedef struct {
    float ax, ay, az; // calibration data for accelerometer
    float gx, gy, gz; // calibration data for gyroscope
} SensorData;

// calculate pitch and roll angles
void calculateAngles(const SensorData* data, float* pitch, float* roll) {
    if (data == NULL || pitch == NULL || roll == NULL) {
        return;
    }

    // calculate pitch angle Pitch
    *pitch = atan2f(data->ay, sqrtf(data->ax * data->ax + data->az * data->az));
    // calculate roll angle Roll
    *roll = atan2f(-data->ax, data->az);

    //  convert radians to degrees
    *pitch *= 180.0f / 3.1415926f;
    *roll *= 180.0f / 3.1415926f;
}

int main(void) {
    const struct device *dev = device_get_binding("MPU6050");
    if (!dev) {
        printf("Failed to find sensor device\n");
        return 1;
    }

    while (1) {
        SensorData data;
        struct sensor_value accel[3], gyro[3];
        float pitch = 0.0f, roll = 0.0f;

        sensor_sample_fetch(dev);
        sensor_channel_get(dev, SENSOR_CHAN_ACCEL_XYZ, accel);
        sensor_channel_get(dev, SENSOR_CHAN_GYRO_XYZ, gyro);

        data.ax = sensor_value_to_double(&accel[0]);
        data.ay = sensor_value_to_double(&accel[1]);
        data.az = sensor_value_to_double(&accel[2]);
        data.gx = sensor_value_to_double(&gyro[0]);
        data.gy = sensor_value_to_double(&gyro[1]);
        data.gz = sensor_value_to_double(&gyro[2]);

        calculateAngles(&data, &pitch, &roll);

        printf("Pitch: %lf degrees\n", (double)pitch);
        printf("Roll: %lf degrees\n", (double)roll);

        k_sleep(K_MSEC(100));
    }

    return 0;
}
```

## src/axp192.c
```c
#include <zephyr/kernel.h>
#include <zephyr/device.h>
#include <zephyr/drivers/display.h>
#include <zephyr/drivers/gpio.h>
#include <zephyr/drivers/regulator.h>
#include <zephyr/lvgl.h>

struct display_buffer_descriptor desc;


static lv_obj_t * create_label(lv_obj_t *parent, const char *text) {
    lv_obj_t *label = lv_label_create(parent);
    lv_label_set_text(label, text);
    return label;
}


static void display_setup(void) {
    const struct device *display_dev = device_get_binding("ILI9341");
    if (display_dev == NULL) {
        printk("Cannot find display device!\n");
        return;
    }

    lv_init();
    lvgl_driver_init();

    lv_disp_drv_t disp_drv;
    lv_disp_drv_init(&disp_drv);
    disp_drv.flush_cb = lvgl_display_flush;
    disp_drv.hor_res = 320;
    disp_drv.ver_res = 240;
    disp_drv.user_data = display_dev;
    lv_disp_drv_register(&disp_drv);

    lv_obj_t *scr = lv_disp_get_scr_act(NULL);
    create_label(scr, "Hello, M5Core2!");
}


void setup_axp192(void) {
    const struct device *i2c_dev = DEVICE_DT_GET(DT_NODELABEL(i2c0));
    if (!device_is_ready(i2c_dev)) {
        printk("Failed to bind to I2C0\n");
        return;
    }

    const struct device *axp192_dev = DEVICE_DT_GET(DT_NODELABEL(axp192_pmic));

    if (!device_is_ready(axp192_dev)) {
        printk("AXP192 device not ready\n");
        return;
    }

    // 启用LDO3供电给显示器
    const struct device *dcdc3 = DEVICE_DT_GET(DT_NODELABEL(lcd_bg));
    if (!device_is_ready(dcdc3)) {
        printk("LDO3 regulator not ready\n");
        return;
    }

    if (regulator_enable(dcdc3) != 0) {
        printk("Failed to enable LDO3\n");
        return;
    }

    printk("AXP192 setup complete, LDO3 enabled.\n");
}

int main(void) {

    // lv_init();
    // printk("start setup axp192\n");
    // setup_axp192();
    // printk("axp192 setup complete\n");


    // static lv_disp_draw_buf_t disp_buf;
    // static lv_color_t buf_1[MY_DISP_HOR_RES * 10];
    // lv_disp_draw_buf_init(&disp_buf, buf_1, NULL, MY_DISP_HOR_RES * 10);

    // printk("start setup display\n");
    // const struct device *display = DEVICE_DT_GET(DT_NODELABEL(ili9342c));
    // if (!device_is_ready(display)) {
    //     printk("Cannot find display device!\n");
    //     return 0;
    // }
    // printk("display setup complete\n");

    // struct display_buffer_descriptor desc = {
    //     .width = 320,
    //     .height = 240,
    //     .pitch = 320,
    //     .buf_size = 320 * 240 * 2,
    // };

    // desc.width = 320;
    // desc.height = 240;
    // desc.pitch = 320;
    // desc.buf_size = 320 * 240 * 2;

    // uint16_t buf[320 * 240];
    // for (int i = 0; i < 320 * 240; i++) {
    //     buf[i] = 0xFF00; // White color
    // }

    // char buffer[100] = "Hello World";

    // // display_write(display, 0, 0, &desc, buf);
    // display_write(display, 0, 0, &desc, buffer);
    // display_blanking_off(display);


    // printk("Hello World displayed!\n");
    // return 0;
    setup_axp192();
    display_setup();
    while (1) {
        lv_task_handler();
        k_sleep(K_MSEC(10));
    }
    return 0;
}
```

## src/lvgl.c
```c
#include <zephyr/device.h>
#include <zephyr/devicetree.h>
#include <zephyr/drivers/display.h>
#include <zephyr/drivers/gpio.h>
#include <lvgl.h>
#include <stdio.h>
#include <string.h>
#include <zephyr/kernel.h>
#include <lvgl_input_device.h>
#include <zephyr/drivers/sensor.h>
#include <math.h>
#include <zephyr/types.h>

// #define LOG_LEVEL CONFIG_LOG_DEFAULT_LEVEL
// #include <zephyr/logging/log.h>
// LOG_MODULE_REGISTER(app);

// int main(void)
// {
// 	char count_str[11] = {0};
// 	const struct device *display_dev;
// 	lv_obj_t *hello_world_label;
// 	lv_obj_t *count_label;
// 	lv_style_t label_style;
// 	lv_style_init(&label_style);
	
// 	lv_style_set_text_color(&label_style, lv_color_hex(0xFF0000));

// 	display_dev = DEVICE_DT_GET(DT_CHOSEN(zephyr_display));
// 	if (!device_is_ready(display_dev)) {
// 		LOG_ERR("Device not ready, aborting test");
// 		return 0;
// 	}

// 	hello_world_label = lv_label_create(lv_scr_act());
// 	lv_obj_add_style(hello_world_label, &label_style, LV_PART_MAIN);
// 	lv_label_set_text(hello_world_label, "+");
// 	lv_obj_align(hello_world_label, LV_ALIGN_CENTER, 0, 0);

// 	lv_task_handler();
// 	display_blanking_off(display_dev);

// 	// while (1) {
//     //     // lv_label_set_text(count_label, count_str);
// 	// 	lv_task_handler();
// 	// 	k_sleep(K_MSEC(10));
// 	// }
// }


// #include <zephyr/device.h>
// #include <zephyr/devicetree.h>
// #include <zephyr/drivers/display.h>
// #include <zephyr/drivers/gpio.h>
// #include <lvgl.h>
// #include <stdio.h>
// #include <string.h>
// #include <zephyr/kernel.h>
// #include <lvgl_input_device.h>

#define LOG_LEVEL CONFIG_LOG_DEFAULT_LEVEL
#include <zephyr/logging/log.h>
LOG_MODULE_REGISTER(app);

static void event_handler(lv_event_t *e) {
    lv_obj_t *label = lv_event_get_user_data(e);
    lv_event_code_t code = lv_event_get_code(e);
    
    uint32_t colors[] = {0xFF0000,0x00FF00,0x0000FF};
    static int color_index = 0;

    if (code == LV_EVENT_CLICKED) {
        color_index = (color_index + 1) % 3;  // Cycle through colors
        lv_obj_t *scr = lv_scr_act();
        lv_obj_set_style_bg_color(scr, lv_color_hex(colors[color_index]), LV_PART_MAIN);
        // lv_obj_add_style(label, &style, LV_PART_MAIN);
        // lv_style_reset(&style); // Reset style to avoid memory leaks
    }
}


int main(void) {
    const struct device *display_dev = DEVICE_DT_GET(DT_CHOSEN(zephyr_display));
    if (!device_is_ready(display_dev)) {
        LOG_ERR("Display device not ready, aborting test");
        return 0;
    }

    lv_init();

    lv_obj_t *label = lv_label_create(lv_scr_act());
    lv_label_set_text(label, "Change my color!");
    lv_obj_align(label, LV_ALIGN_CENTER, 0, 0);

    lv_obj_t *increase_btn = lv_btn_create(lv_scr_act());
    lv_obj_add_event_cb(increase_btn, event_handler, LV_EVENT_CLICKED, label);
    lv_label_set_text(lv_label_create(increase_btn), "Change Color");
    lv_obj_align(increase_btn, LV_ALIGN_CENTER, 0, 50);

    display_blanking_off(display_dev);
    lv_task_handler();

    while (1) {
        lv_task_handler();
        k_sleep(K_MSEC(10));
    }
}
```
