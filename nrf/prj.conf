## CMakeLists.txt
```
# SPDX-License-Identifier: Apache-2.0

cmake_minimum_required(VERSION 3.20.0)

find_package(Zephyr REQUIRED HINTS $ENV{ZEPHYR_BASE})
project(../../pjt)

FILE(GLOB app_sources src/*.c)

include_directories(./../mylib/)

target_sources(app PRIVATE ./../mylib/nrf/ahu_ble.c
                           ./../mylib/nrf/ahu_ir.c
                           ./src/main.c)
```

## prj.conf
```kconfig
# 开启蓝牙
CONFIG_BT=y
CONFIG_BT_OBSERVER=y
# Enable Extended Scanning
CONFIG_BT_EXT_ADV=y
CONFIG_BT_EXT_SCAN_BUF_SIZE=1650
# Zephyr Bluetooth LE Controller needs 16 event buffers to generate Extended
# Advertising Report for receiving the complete 1650 bytes of data
CONFIG_BT_BUF_EVT_RX_COUNT=16

# Set maximum scan data length for Extended Scanning in Bluetooth LE Controller
CONFIG_BT_CTLR_SCAN_DATA_LEN_MAX=1650

# Increase Zephyr Bluetooth LE Controller Rx buffer to receive complete chain
# of PDUs
CONFIG_BT_CTLR_RX_BUFFERS=9
# CONFIG_BT_PERIPHERAL=y

# CONFIG_BT_SMP=y
# CONFIG_BT_GATT_CLIENT=y

# 启用蓝牙广告
CONFIG_BT_BROADCASTER=y

CONFIG_SERIAL=y
CONFIG_UART_INTERRUPT_DRIVEN=y

CONFIG_LOG=y
CONFIG_ASSERT=n
CONFIG_LOG_PRINTK=y
CONFIG_LOG_MIPI_SYST_ENABLE=n

CONFIG_COVERAGE=n

CONFIG_LOG_BACKEND_UART=y
CONFIG_LOG_BACKEND_UART_OUTPUT_SYST=n

CONFIG_SOC_LOG_LEVEL_OFF=y
CONFIG_ARCH_LOG_LEVEL_OFF=y
CONFIG_KERNEL_LOG_LEVEL_OFF=y
CONFIG_LOG_RUNTIME_FILTERING=n
CONFIG_MAIN_THREAD_PRIORITY=5
CONFIG_LOG_FUNC_NAME_PREFIX_DBG=n

CONFIG_LOG_MODE_IMMEDIATE=n

CONFIG_HEAP_MEM_POOL_SIZE=1024

# 允许GATT服务
# CONFIG_BT_GATT=y

# 增加蓝牙连接的数量（如果需要）
# CONFIG_BT_MAX_CONN=2

# 启用系统的日志记录功能
# CONFIG_LOG=y

CONFIG_GPIO=y
# Need bigger stack for immediate mode
CONFIG_MAIN_STACK_SIZE=4096

CONFIG_BT_DEVICE_NAME="DY TEST"
```

## boards/nrf52840dk_nrf528409.overlay
```dts
/ {
    led0: led_0 {
			gpios = <&gpio1 8 GPIO_ACTIVE_LOW>;
			label = "Green_LED_0";
	};
};
```

## src/main.c
```c
/*
 * Copyright (c)
 *
 */
#include <zephyr/kernel.h>
#include <zephyr/device.h>
#include <zephyr/drivers/gpio.h>
#include <zephyr/sys/printk.h>
#include <zephyr/sys/__assert.h>
#include <string.h>

#include "./../../mylib/nrf/ahu_ble.h"
#include "./../../mylib/nrf/ahu_ir.h"

#define MY_STACK_SIZE 4096
#define MY_PRIORITY 5

/**
 * @brief Thread to process the system
*/
K_THREAD_DEFINE(ble_id, MY_STACK_SIZE, ahu_ble_thread, NULL, NULL, NULL,
        MY_PRIORITY, 0, 0);
K_THREAD_DEFINE(ir_id, MY_STACK_SIZE, ir_tx_thread, NULL, NULL, NULL,
        MY_PRIORITY, 0, 0);

int main(void) {
//     k_thread_start(ble_id);
    k_thread_start(ir_id);
}
```
